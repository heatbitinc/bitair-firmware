## components/asic/Kconfig
```kconfig
menu "ASIC frequency transition"

    config ASIC_FREQ_RAMP_STEP_MULT
        int "Frequency ramp step, in 6.25 MHz units"
        range 1 32
        default 1
        help
            Frequency changes are applied in steps so the chip and the core
            regulator follow the load change. A larger step makes start, stop
            and live frequency changes faster.

    config ASIC_FREQ_RAMP_STEP_DELAY_MS
        int "Delay between frequency ramp steps (ms)"
        range 10 1000
        default 100

endmenu
```

## components/bitair_hw/Kconfig
```kconfig
menu "Bitair peripherals"

    config INDICATION_LED_ACTIVE_LEVEL
        int "Indication LED active level"
        range 0 1
        default 1
        help
            Logic level that turns the indication LED on.
            1 = active-high (default), 0 = active-low.

    choice PWM_DUTY_LOG_LEVEL
        prompt "PWM duty monitor log detail"
        default PWM_DUTY_LOG_BASIC
        help
            Controls verbosity for PWM duty monitor diagnostics.

        config PWM_DUTY_LOG_OFF
            bool "Off"
            help
                Disable PWM duty monitor informational/warning diagnostics.

        config PWM_DUTY_LOG_BASIC
            bool "Basic"
            help
                Log startup configuration and fan mode/power state changes.

        config PWM_DUTY_LOG_VERBOSE
            bool "Verbose"
            help
                Log per-cycle PWM input snapshots and detailed debounce traces.
    endchoice

endmenu
```

## components/device_identity/Kconfig
```kconfig
menu "Device identity"

    config HEATBIT_DEVICE_TYPE
        string "Device type reported at enrollment"
        default "bitair"

    config HEATBIT_DEVICES_DNS_SUFFIX
        string "Device certificate DNS suffix"
        default ""
        help
            The device certificate names <device_uuid>.<suffix> in CN and SAN.

    config HEATBIT_ENROLL_ENABLED
        bool "Renew the device client certificate"
        default n
        help
            Before the device certificate expires, the device generates a new
            EC P-256 key, sends a CSR to the enrollment service (authenticated
            with the current certificate) and stores the new certificate in
            NVS. Requires certs/ca_root.pem: the root CA that signed the
            enrollment server certificate.

    config HEATBIT_ENROLL_URL
        string "Enrollment URL"
        depends on HEATBIT_ENROLL_ENABLED
        default ""
        help
            Full URL of the enrollment endpoint.

endmenu
```

## components/heatbit/Kconfig.projbuild
```kconfig
menu "Heatbit Configuration"

    comment "Backend endpoints have no defaults: set them in sdkconfig.defaults.heatbit"

    config HEATBIT_API_HOST
        string "Heatbit API host"
        default ""
        help
            Hostname of the Heatbit API backend, used for all REST and
            WebSocket URLs.

    config HEATBIT_API_METRICS_PATH
        string "Metrics path"
        default ""
        help
            Path of the metrics endpoint, appended to the API host.

    config HEATBIT_API_POOL_CONFIG_PATH
        string "Pool config path"
        default ""
        help
            Path of the pool configuration endpoint, appended to the API host.

    config HEATBIT_API_WS_PATH
        string "WebSocket port and path"
        default ""
        help
            Port and path of the WebSocket endpoint, appended to the API host.

    config HEATBIT_OTA_SERVER_URL
        string "OTA server URL"
        default ""
        help
            Base URL of the firmware update server. Leave empty to disable
            update checks.

    config HEATBIT_OTA_VERSION_PATH
        string "OTA version path"
        default ""
        help
            Path of the latest-version request, appended to the OTA server URL.

    config HEATBIT_OTA_DOWNLOAD_PATH
        string "OTA download path"
        default ""
        help
            Path of the firmware image download, appended to the OTA server URL.

    config HEATBIT_MQTT_BROKER_HOST
        string "MQTT broker host"
        default ""
        help
            Hostname or IPv4 address of the MQTT broker used for telemetry
            and command channels.

    config HEATBIT_MQTT_BROKER_PORT
        int "MQTT broker port"
        range 1 65535
        default 8883
        help
            TLS MQTT broker port.

    config HEATBIT_MQTT_TELEMETRY_TOPIC
        string "MQTT telemetry topic"
        default ""
        help
            Topic the device publishes telemetry to. "%s" is replaced with the
            device UUID.

    config HEATBIT_MQTT_COMMANDS_TOPIC
        string "MQTT commands topic"
        default ""
        help
            Topic the device subscribes to for commands. "%s" is replaced with
            the device UUID.
endmenu
```

## components/wifi_manager/Kconfig
```kconfig
menu "Wi-Fi"

    config ESP_WIFI_SSID
        string "WiFi SSID"
        default ""
        help
            SSID of the default network used when no credentials are stored.

    config ESP_WIFI_PASSWORD
        string "WiFi Password"
        default ""
        help
            Password of the default network.

endmenu
```

## main/Kconfig.projbuild
```kconfig
menu "Bitair Configuration"

    menu "GPIO Pin Configuration"

        config GPIO_BUTTON_BOOT
            int "Boot button GPIO pin"
            default 0
            help
                GPIO pin connected to the BOOT button.

        config GPIO_ASIC_RESET
            int "ASIC reset GPIO pin"
            default 1
            help
                GPIO pin for ASIC_RESET (RST_N), reset input to ASIC.

        config GPIO_ASIC_ENABLE
            int "ASIC enable GPIO pin"
            default 10
            help
                GPIO pin for ASIC_ENABLE (POWER_EN), enable for core power supply.

        config GPIO_PLUG_SENSE
            int "Barrel plug sense GPIO pin"
            default 12
            help
                GPIO pin for DC barrel (PLUG_SENSE), sense pin of DC power jack socket.

        config GPIO_I2C_SDA
            int "I2C SDA Pin"
            default 47
            help
                GPIO pin for I2C clock line (SDA).
            
        config GPIO_I2C_SCL
            int "I2C SCL Pin"
            default 48
            help
                GPIO pin for I2C clock line (SCL).

    endmenu

    config BITAIR_VF_CALIBRATION
        bool "Run voltage/frequency calibration after mining starts (development)"
        default n
            help
            Steps through frequencies and core voltages, logging hashrate,
            ASIC errors, current and temperatures as VFCAL lines. Drives the
            chip outside its normal settings: development only, never in
            release builds. Disable the thermal governor while calibrating.

    menu "Thermal governor"

        config THERMAL_GOVERNOR_ENABLED
            bool "Lower the ASIC frequency while hot, without stopping mining"
            default y
            help
                While the chip or the core regulator runs hot, the frequency is
                lowered in steps by a partial ramp, and raised again once both
                have cooled down. The emergency overheat stop (chip above 75 C,
                regulator above 105 C) still cuts power.

        config THERMAL_GOVERNOR_CHIP_THROTTLE_C
            int "Chip temperature to start slowing down (C)"
            default 70

        config THERMAL_GOVERNOR_CHIP_RECOVER_C
            int "Chip temperature to allow speeding up (C)"
            default 65

        config THERMAL_GOVERNOR_VR_THROTTLE_C
            int "Regulator temperature to start slowing down (C)"
            default 95

        config THERMAL_GOVERNOR_VR_RECOVER_C
            int "Regulator temperature to allow speeding up (C)"
            default 85

        config THERMAL_GOVERNOR_STEP_MHZ
            int "Frequency step per adjustment (MHz)"
            range 5 200
            default 25

        config THERMAL_GOVERNOR_DOWN_INTERVAL_MS
            int "Minimum time between slow-downs (ms)"
            default 5000

        config THERMAL_GOVERNOR_UP_INTERVAL_MS
            int "Minimum time before speeding up again (ms)"
            default 30000

        config THERMAL_GOVERNOR_MIN_FREQUENCY_MHZ
            int "Lowest frequency the governor may set (MHz)"
            default 300

        config THERMAL_GOVERNOR_UV_PER_MHZ
            int "Core voltage reduction per MHz of throttle (uV/MHz)"
            range 0 5000
            default 0
            help
                0 keeps the core voltage unchanged while throttled. A positive
                value lowers it with the frequency, e.g. 500 uV/MHz gives
                -100 mV at -200 MHz. Calibrate against the chip's stable
                voltage/frequency curve before enabling.

        config THERMAL_GOVERNOR_MIN_VOLTAGE_MV
            int "Lowest core voltage the governor may set (mV)"
            default 1000
            
    endmenu
    
    config ASIC_VOLTAGE
        int "ASIC Core Voltage (mV)"
        range 1000 1800
        default 1250
        help
            The core voltage to set the ASIC to.

    config ASIC_FREQUENCY
        int "ASIC Hash Frequency (MHz)"
        range 50 800
        default 600
        help
            The BM1370 hash frequency

    config FORCE_MINING_DISABLED
        bool "Force mining disabled"
        default n
        help
            If enabled, mining stays disabled regardless of runtime requests
            from PWM/state services.

    config MONITOR_LOGGING_ENABLED
        bool "Enable runtime monitor logging"
        default n
        help
            Enable or disable runtime ESP logging output in monitor.
            When disabled, app_main sets global log level to NONE for all tags.

    config ENABLE_AHT20_SENSOR
        bool "Enable AHT20 temperature/humidity sensor"
        default y
        help
            Enable the AHT20 temperature/humidity sensor on the shared I2C bus
            (address 0x38). Without the sensor the service disables itself at
            startup, so this can stay on for all Bitair variants.

    config OTA_CHECK_INTERVAL_S
        int "OTA check interval (seconds)"
        range 60 86400
        default 600
        help
            Period between OTA update checks in seconds.
            Default is 600 seconds (10 minutes).


    choice FAN_PWM_FREQUENCY_PRESET_VALUE
        prompt "Fan PWM frequency preset"
        default FAN_PWM_FREQ_1400
        help
            Predefined fan PWM frequencies. The driver maps these to the
            nearest supported hardware register value.

        config FAN_PWM_FREQ_22500
            bool "22500 Hz"

        config FAN_PWM_FREQ_11250
            bool "11250 Hz"

        config FAN_PWM_FREQ_5600
            bool "5600 Hz"

        config FAN_PWM_FREQ_1400
            bool "1400 Hz"
    endchoice

    config FAN_PWM_FREQUENCY_HZ_EFFECTIVE
        int
        default 22500 if FAN_PWM_FREQ_22500
        default 11250 if FAN_PWM_FREQ_11250
        default 5600 if FAN_PWM_FREQ_5600
        default 1400 if FAN_PWM_FREQ_1400
endmenu

menu "Stratum Configuration"

    config STRATUM_URL
        string "Stratum Address"
        default "solo.pool.heatbit.com"
        help
            The example will connect to this Stratum pool address.

    config STRATUM_PORT
        int "Stratum Port"
        range 0 65535
        default 13333
        help
            The stratum server port to connect to.
    
    choice
        prompt "Stratum TLS mode"
        default STRATUM_TLS_DISABLED
        help
            Select how TLS is used for stratum connections.

        config STRATUM_TLS_DISABLED
            bool "Disabled"

        config STRATUM_TLS_BUNDLED
            bool "Enabled (bundled CA certificate)"

        config STRATUM_TLS_CUSTOM
            bool "Enabled (user-provided/custom CA certificate)"
    endchoice

    config STRATUM_TLS
        int
        default 0 if STRATUM_TLS_DISABLED
        default 1 if STRATUM_TLS_BUNDLED
        default 2 if STRATUM_TLS_CUSTOM
    
    config STRATUM_CERT
        string "Stratum Certificate"
        default "x"
        help
            The certificate to use with the stratum connection.

    config EXTRANONCE_SUBSCRIBE
        bool "Pool extranonce subscribe"
        default n
        help
            Enable stratum extranonce subscribe.

    config FALLBACK_STRATUM_URL
        string "Fallback Stratum Address"
        default "solo.pool.heatbit.com"
        help
            The example will connect to this Stratum pool address if the primary fails.

    config FALLBACK_STRATUM_PORT
        int "Fallback Stratum Port"
        range 0 65535
        default 13333
        help
            The stratum server port to connect to if the primary fails.
    
    choice
        prompt "Fallback Stratum TLS mode"
        default FALLBACK_STRATUM_TLS_DISABLED
        help
            Select how TLS is used for stratum connections.

        config FALLBACK_STRATUM_TLS_DISABLED
            bool "Disabled"

        config FALLBACK_STRATUM_TLS_BUNDLED
            bool "Enabled (bundled CA certificate)"

        config FALLBACK_STRATUM_TLS_CUSTOM
            bool "Enabled (user-provided/custom CA certificate)"
    endchoice

    config FALLBACK_STRATUM_TLS
        int
        default 0 if FALLBACK_STRATUM_TLS_DISABLED
        default 1 if FALLBACK_STRATUM_TLS_BUNDLED
        default 2 if FALLBACK_STRATUM_TLS_CUSTOM
    
    config FALLBACK_STRATUM_CERT
        string "Fallback Stratum Certificate"
        default "x"
        help
            The certificate to use with the stratum connection if the primary fails.

    config FALLBACK_EXTRANONCE_SUBSCRIBE
        bool "Fallback pool extranonce subscribe"
        default n
        help
            Enable fallback pool extranonce subscribe.

    config STRATUM_USER
        string "Stratum username"
        default "replace-this-with-your-btc-address.bitair"
        help
            Stratum user to use with pool

    config STRATUM_PW
        string "Stratum password"
        default "x"
        help
            Stratum password to use with pool

    config FALLBACK_STRATUM_USER
        string "Fallback Stratum username"
        default "replace-this-with-your-btc-address.bitair"
        help
            Fallback Stratum user to use with pool

    config FALLBACK_STRATUM_PW
        string "Fallback Stratum password"
        default "x"
        help
            Fallback Stratum password to use with pool

    config STRATUM_DIFFICULTY
        int "Stratum default difficulty"
        range 0 4294967296
        default 1000
        help
            A starting difficulty to use with the pool.

    config FALLBACK_STRATUM_DIFFICULTY
        int "Fallback stratum default difficulty"
        range 0 4294967296
        default 1000
        help
            A starting difficulty to use with the fallback pool.

    config ENABLE_TASK_MONITOR
        bool "Task Monitor"
        default n
        help
            Enable task monitor. NOTE: This is intended for debugging use only as the use of uxTaskGetSystemState results in the scheduler remaining suspended for an extended period.

endmenu
```

## test-ci/sdkconfig.defaults
```kconfig
CONFIG_ESP_INT_WDT=n
CONFIG_ESP_TASK_WDT=n
CONFIG_BT_ENABLED=y
CONFIG_BT_NIMBLE_ENABLED=y
CONFIG_UNITY_ENABLE_64BIT=y
```
